## arch/riscv/Kconfig.socs
```kconfig
menu "SoC selection"

config ARCH_ANDES
	bool "Andes SoCs"
	depends on MMU && !XIP_KERNEL
	select ERRATA_ANDES
	help
	  This enables support for Andes SoC platform hardware.

config ARCH_ESWIN
	bool "ESWIN SoCs"
	help
	  This enables support for ESWIN SoC platform hardware,
	  including the ESWIN EIC7700 SoC.

config ARCH_MICROCHIP_POLARFIRE
	def_bool ARCH_MICROCHIP

config ARCH_MICROCHIP
	bool "Microchip SoCs"
	help
	  This enables support for Microchip SoC platforms.

config ARCH_RENESAS
	bool "Renesas RISC-V SoCs"
	help
	  This enables support for the RISC-V based Renesas SoCs.

config ARCH_SIFIVE
	bool "SiFive SoCs"
	select ERRATA_SIFIVE if !XIP_KERNEL
	help
	  This enables support for SiFive SoC platform hardware.

config ARCH_SOPHGO
	bool "Sophgo SoCs"
	help
	  This enables support for Sophgo SoC platform hardware.

config ARCH_SPACEMIT
	bool "SpacemiT SoCs"
	select PINCTRL
	help
	  This enables support for SpacemiT SoC platform hardware.

config ARCH_STARFIVE
	def_bool SOC_STARFIVE

config SOC_STARFIVE
	bool "StarFive SoCs"
	select PINCTRL
	select RESET_CONTROLLER
	select ARM_AMBA
	help
	  This enables support for StarFive SoC platform hardware.

config ARCH_SUNXI
	bool "Allwinner sun20i SoCs"
	depends on MMU && !XIP_KERNEL
	select ERRATA_THEAD
	select SUN4I_TIMER
	help
	  This enables support for Allwinner sun20i platform hardware,
	  including boards based on the D1 and D1s SoCs.

config ARCH_THEAD
	bool "T-HEAD RISC-V SoCs"
	depends on MMU && !XIP_KERNEL
	select ERRATA_THEAD
	select PM_GENERIC_DOMAINS if PM
	help
	  This enables support for the RISC-V based T-HEAD SoCs.

config ARCH_VIRT
	bool "QEMU Virt Machine"
	select POWER_RESET
	select POWER_RESET_SYSCON
	select POWER_RESET_SYSCON_POWEROFF
	select GOLDFISH
	select RTC_DRV_GOLDFISH if RTC_CLASS
	select PM_GENERIC_DOMAINS if PM
	select PM_GENERIC_DOMAINS_OF if PM && OF
	select RISCV_SBI_CPUIDLE if CPU_IDLE && RISCV_SBI
	help
	  This enables support for QEMU Virt Machine.

config ARCH_CANAAN
	bool "Canaan Kendryte SoC"
	help
	  This enables support for Canaan Kendryte series SoC platform hardware.

config SOC_CANAAN_K210
	bool "Canaan Kendryte K210 SoC"
	depends on !MMU && ARCH_CANAAN
	select ARCH_HAS_RESET_CONTROLLER
	select PINCTRL
	select COMMON_CLK
	help
	  This enables support for Canaan Kendryte K210 SoC platform hardware.

config ARCH_ESPRESSIF
	bool "Espressif RISC-V SoCs"
	help
	  This enables support for Espressif RISC-V SoCs.

config SOC_ESP32S31
	def_bool ARCH_ESPRESSIF && 32BIT

config ESP32S31_RADIO_SMODE
	bool "ESP32-S31 radio: built-in kernel support"
	depends on SOC_ESP32S31 && MMU && XIP_KERNEL
	depends on RISCV_NO_ASID
	help
	  Built-in support for esp32s31-radio.ko, which runs Espressif's
	  closed Wi-Fi, Bluetooth and PHY libraries. Those libraries use
	  absolute addresses. This option:

	  - maps the modem and peripheral windows, the internal SRAM and
	    the mask ROM at their physical addresses in init_mm, and copies
	    the cache-register, SRAM and ROM entries into every process's
	    page table, so these kernel-only mappings sit below TASK_SIZE
	    in every process;
	  - emulates kernel-mode reads of mhartid;
	  - adds a hook to the generic idle loop that keeps hart 0 polling
	    while the radio asks for it;
	  - exports kernel helpers to the module;
	  - turns on ESP32S31_RADIO_XIP, the fixed mapping of the radio's
	    flash slot and its Wi-Fi IRAM alias.

	  Say N unless you run esp32s31-radio.ko.

endmenu # "SoC selection"
```

## drivers/platform/Kconfig
```kconfig
# SPDX-License-Identifier: GPL-2.0-only

config ESP32S31_RADIO_XIP
	bool
	depends on ESP32S31_RADIO_SMODE
	select CRC32
	default y
	help
	  Fixed executable flash mapping and 40 KiB writable SRAM arena.
	  The radio image and Linux module must be built together.

config ESP32S31_RADIO_SMODE_DRIVER
	tristate "ESP32-S31 S-mode radio runtime"
	depends on ESP32S31_RADIO_XIP
	depends on WLAN && m
	select CFG80211
	select MAC80211
	help
	  Build the reloadable esp32s31-radio.ko. It owns the shared PHY, SRAM,
	  clocks and interrupts and exposes cfg80211 from one module. The
	  prelinked ESP-IDF closure (radio.bin) runs from its fixed flash-XIP
	  slot. Built without Bluetooth: only mode=wifi works.

config ESP32S31_WIFI_SOFTMAC
	bool
	depends on ESP32S31_RADIO_SMODE_DRIVER && MAC80211
	default y
	help
	  Single-STA mac80211 bridge with native MAC CCMP, bounded TX
	  aggregation and software replay/reorder checks on received frames.

config ESP32S31_RADIO_BLOBS
	bool
	depends on ESP32S31_RADIO_SMODE_DRIVER
	default y

source "drivers/platform/mips/Kconfig"

source "drivers/platform/loongarch/Kconfig"

source "drivers/platform/goldfish/Kconfig"

source "drivers/platform/chrome/Kconfig"

source "drivers/platform/cznic/Kconfig"

source "drivers/platform/mellanox/Kconfig"

source "drivers/platform/olpc/Kconfig"

source "drivers/platform/surface/Kconfig"

source "drivers/platform/x86/Kconfig"

source "drivers/platform/arm64/Kconfig"
```
